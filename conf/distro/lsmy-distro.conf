## conf/distro/lsmy-distro.conf
```bitbake
# lsmy-distro.conf
# Custom distribution configuration for LSMY project

require conf/distro/poky.conf

DISTRO = "lsmy-distro"
DISTRO_NAME = "LSMY Lab Monitoring Distribution"
DISTRO_VERSION = "1.0"
DISTRO_CODENAME = "scarthgap"

# Use systemd as init manager
DISTRO_FEATURES:append = " systemd usrmerge"
DISTRO_FEATURES:remove = "sysvinit"
VIRTUAL-RUNTIME_init_manager = "systemd"
VIRTUAL-RUNTIME_initscripts = "systemd-compat-units"

# Use IPK as package format
PACKAGE_CLASSES = "package_ipk"

# Remove SPDX
INHERIT:remove = "create-spdx"

# Enable package index
# INHERIT:append = " package-index"

# Enable extra users
INHERIT:append = " extrausers"

EXTRA_USERS_PARAMS = "\
    useradd -p '' admin; \
    useradd -p '' user; \
    usermod -aG sudo admin; \
"

# Enable package signing
INHERIT:append = " sign_ipk"

GPG_PATH = "/home/ironman/.gnupg"
GPG_NAME = "thanhkoten3@gmail.com"
GPG_PASSPHRASE = "25092004"

# Use X11 as graphics backend
# DISTRO_FEATURES:append = " x11"

# Use wayland as graphics backend
DISTRO_FEATURES:remove = "x11"
DISTRO_FEATURES:append = " wayland pam"

# Use TensorFlow Lite
DISTRO_FEATURES:append = " tensorflow-lite"
PREFERRED_VERSION_tensorflow-lite = "2.9.1"

# Enable fortran support
FORTRAN:forcevariable = ",fortran"

PACKAGECONFIG:append:pn-gcc = " fortran"
PACKAGECONFIG:append:pn-gcc-cross-aarch64 = " fortran"
PACKAGECONFIG:append:pn-gcc-runtime = " fortran"
PACKAGECONFIG:append:pn-gcc-crosssdk = " fortran"
```

## conf/layer.conf
```bitbake
# We have a conf and classes directory, add to BBPATH
BBPATH .= ":${LAYERDIR}"

# We have recipes-* directories, add to BBFILES
BBFILES += "${LAYERDIR}/recipes-*/*/*.bb \
            ${LAYERDIR}/recipes-*/*/*.bbappend"

BBFILE_COLLECTIONS += "meta-lsmy"
BBFILE_PATTERN_meta-lsmy = "^${LAYERDIR}/"
BBFILE_PRIORITY_meta-lsmy = "6"

LAYERDEPENDS_meta-lsmy = "core"
LAYERSERIES_COMPAT_meta-lsmy = "scarthgap"

FORTRAN:forcevariable = ",fortran"

PACKAGECONFIG:append:pn-gcc = " fortran"
PACKAGECONFIG:append:pn-gcc-cross-aarch64 = " fortran"
PACKAGECONFIG:append:pn-gcc-runtime = " fortran"
PACKAGECONFIG:append:pn-gcc-crosssdk = " fortran"

PREFERRED_VERSION_tensorflow-lite = "2.9.1"
```

## conf/machine/raspberrypi4-lsmy.conf
```bitbake
# Custom machine for Raspberry Pi 4 (LSMY)
# Extends the upstream raspberrypi4 machine

require conf/machine/raspberrypi4.conf

# Map custom machine to upstream Raspberry Pi 4 BSP
KERNEL_MACHINE = "raspberrypi4"

# Inherit raspberrypi4 kernel & BSP overrides
MACHINEOVERRIDES .= ":raspberrypi4"

# Enable common peripherals
ENABLE_UART = "1"
ENABLE_I2C  = "1"
ENABLE_I2C1 = "1"

# Enable camera support
# ENABLE_CAMERA = "1"
# VIDEO_CAMERA = "1"

# Camera-specific configurations
KERNEL_MODULE_AUTOLOAD:append = " ov5647 bcm2835_unicam bcm2835-isp"

RPI_KERNEL_DEVICETREE_OVERLAYS:append = " \
    overlays/ov5647.dtbo \
"

RPI_EXTRA_CONFIG:append = "\
dtoverlay=ov5647 \n\
camera_auto_detect=1 \n\
media-controller=1 \n\
gpu_mem=128 \n\
"
```
